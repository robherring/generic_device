## Kconfig
```kconfig
mainmenu "Android Device Configuration"

menu "Target Architecture"

choice
	prompt "Target Arch"
	default ARCH_ARM64

config ARCH_ARM
	bool "arm"

config ARCH_ARM64
	bool "arm64"
	select 64_BIT

config ARCH_X86_64
	bool "x86_64"
	select 64_BIT

endchoice

config 64_BIT
	bool

config HAS_ARM_NEON
	bool "Enable ARM Neon Support"
	depends on ARCH_ARM
	default y

config HAS_2ND_ARCH
	bool "Include 2nd Arch" if 64_BIT
	default y

config TARGET_ARCH
	string
	default "arm" if ARCH_ARM
	default "arm64" if ARCH_ARM64
	default "x86_64" if ARCH_X86_64

config TARGET_ARCH_VARIANT
	string
	default "armv7-a" if ARCH_ARM && !HAS_ARM_NEON
	default "armv7-a-neon" if HAS_ARM_NEON
	default "armv8-a" if ARCH_ARM64
	default "x86_64" if ARCH_X86_64

config TARGET_CPU_VARIANT
	string
	default "generic"

config TARGET_CPU_ABI
	string
	default "armeabi-v7a" if ARCH_ARM
	default "arm64-v8a" if ARCH_ARM64
	default "x86_64" if ARCH_X86_64

config TARGET_CPU_ABI2
	string
	default "armeabi" if ARCH_ARM

if HAS_2ND_ARCH

config TARGET_2ND_ARCH
	string
	default "arm" if ARCH_ARM64
	default "x86" if ARCH_X86_64

config TARGET_2ND_ARCH_VARIANT
	string
	default "armv7-a-neon" if ARCH_ARM64
	default "x86_64" if ARCH_X86_64

config TARGET_2ND_CPU_VARIANT
	string
	default "cortex-a15" if ARCH_ARM64

config TARGET_2ND_CPU_ABI
	string
	default "armeabi-v7a" if ARCH_ARM64
	default "x86" if ARCH_X86_64

config TARGET_2ND_CPU_ABI2
	string
	default "armeabi" if ARCH_ARM64

endif

config PRODUCT_DEVICE
	string "Target Product Device"
	help
	  This is the device name used for the build output. Set it only
	  to have a custom non-shared build.

config TARGET_USES_64_BIT_BINDER
	def_bool ARCH_ARM64 || ARCH_X86_64

choice
	prompt "Device Type"
	default TABLET

config TABLET
	bool "Tablet"

config TV
	bool "TV"
	help
	  Configure the build for Android TV device.

	  This requires the LeanbackLauncher from fugu device available here:
	  https://dl.google.com/dl/android/aosp/google-fugu-3096662-f2671c41.tgz

endchoice
endmenu

config TREBLE
	bool "Enable Treble-ized build"
	help
	  When enabled, this enforces the vendor/system split. Typically a separate
	  vendor image should also be enabled with this, but that isn't strictly
	  required.

menu "Dalvik/ART Heap Configuration"
# Default values are targeted towards 1G RAM

config DALVIK_VM_HEAPSIZE
	int "VM Heap Size (MB)"
	default 256
	range 32 768
	help
	  Typically this is sized to about 1/4 the total RAM size.

config DALVIK_VM_HEAPSTARTSIZE
	int "VM Heap Start Size (MB)"
	default 8
	range 5 32

config DALVIK_VM_HEAPMAXFREE
	int "VM Heap Max Free (MB)"
	default 8
	range 2 8
	help
	  This is the target free space after growing/shrinking the heap. It
	  influences the frequency of garbage collection. Smaller values mean
	  more frequent GC.

config DALVIK_VM_HEAPGROWTHLIMIT
	int "VM Heap Growth Limit (MB)"
	default 96
	range 96 256
	help
	  Typically this is less than half the heap size.

config LOWMEM_CONFIG
	bool "Enable Lowmem Configuration"
	help
	  Enables some of the reccomended low-memory options for devices
	  with 1GB or less RAM.

endmenu

menu "Image Configuration"

config BOARD_SYSTEMIMAGE_FILE_SYSTEM_TYPE
	string
	default "ext4" if SYSTEMIMAGE_FS_EXT4
	default "squashfs" if SYSTEMIMAGE_FS_SQUASHFS

choice
	prompt "System Image Filesystem Type"
	default SYSTEMIMAGE_FS_EXT4
	help
	  BOARD_SYSTEMIMAGE_FILE_SYSTEM_TYPE

config SYSTEMIMAGE_FS_EXT4
	bool "ext4"

config SYSTEMIMAGE_FS_SQUASHFS
	bool "squashfs"

endchoice

config BOARD_SYSTEMIMAGE_PARTITION_SIZE
	int "System Image Size"
	default 734003200
	help
	  BOARD_SYSTEMIMAGE_PARTITION_SIZE

config SEPARATE_VENDOR_IMAGE
	bool "Build separate vendor image file"

config TARGET_COPY_OUT_VENDOR
	string
	default "vendor"
	depends on SEPARATE_VENDOR_IMAGE

if SEPARATE_VENDOR_IMAGE

config BOARD_VENDORIMAGE_FILE_SYSTEM_TYPE
	string
	default "ext4" if VENDORIMAGE_FS_EXT4
	default "squashfs" if VENDORIMAGE_FS_SQUASHFS

choice
	prompt "Vendor Image Filesystem Type"
	default VENDORIMAGE_FS_EXT4
	help
	  BOARD_VENDORIMAGE_FILE_SYSTEM_TYPE

config VENDORIMAGE_FS_EXT4
	bool "ext4"

config VENDORIMAGE_FS_SQUASHFS
	bool "squashfs"

endchoice

config BOARD_VENDORIMAGE_PARTITION_SIZE
	int "Vendor Image Size"
	default 200000000
	help
	  BOARD_VENDORIMAGE_PARTITION_SIZE

endif

config BOARD_USERDATAIMAGE_PARTITION_SIZE
	int "Userdata Image Size"
	default 576716800
	help
	  BOARD_USERDATAIMAGE_PARTITION_SIZE

config TARGET_USERIMAGES_SPARSE_EXT_DISABLED
	bool "Disable sparse filesystem images"
	help
	  TARGET_USERIMAGES_SPARSE_EXT_DISABLED

config DEX_PREOPT
	bool "Enable .dex Pre-Optimations at build time"

endmenu

menuconfig KERNEL
	bool "Kernel"

if KERNEL

config KERNEL_PATH
	string "Kernel Image path"
	default "kernel"

config BOARD_KERNEL_CMDLINE
	string "Kernel Command Line"
	help
	  Enter the kernel command line to be set in the bootimage.

config BOARD_KERNEL_BASE
	hex "Kernel Base Address"
	help
	  Base address to load the kernel

config RAMDISK_OFFSET
	hex "Ramdisk offset"
	help
	  Offset from Kernel Base Address to load the ramdisk

endif

config TARGET_NO_KERNEL
	bool
	default !KERNEL

menu "Device Support"

source "firmware/Kconfig"
source "graphics/Kconfig"
source "bluetooth/Kconfig"
source "wifi/Kconfig"
source "ethernet/Kconfig"
source "sensor/Kconfig"

endmenu
```

## bluetooth/Kconfig
```kconfig
config BLUETOOTH
	bool "Bluetooth support"
	help
	  Select to enable Bluetooth support using standard Linux kernel BT
	  drivers.
```

## configs/db410c_defconfig
```kconfig
CONFIG_ARCH_ARM=y
CONFIG_PRODUCT_DEVICE="db410c"
CONFIG_DALVIK_VM_HEAPSIZE=32
CONFIG_LOWMEM_CONFIG=y
CONFIG_BOARD_SYSTEMIMAGE_PARTITION_SIZE=1288491008
CONFIG_BOARD_USERDATAIMAGE_PARTITION_SIZE=5653544960
CONFIG_KERNEL=y
CONFIG_KERNEL_PATH="device/linaro/generic-kernels/db410c-qcomlt-4.14.gz-dtb"
CONFIG_BOARD_KERNEL_CMDLINE="androidboot.selinux=permissive firmware_class.path=/system/vendor/firmware/"
CONFIG_BOARD_KERNEL_BASE=0x80008000
CONFIG_RAMDISK_OFFSET=0x0
CONFIG_FIRMWARE=y
CONFIG_FIRMWARE_FILES="a300_pfp.fw,a300_pm4.fw"
CONFIG_DISPLAY_DPI=160
CONFIG_BOARD_WLAN_DEVICE="qcwcn"
```

## configs/defconfig
```kconfig
CONFIG_BOARD_SYSTEMIMAGE_PARTITION_SIZE=800000000
CONFIG_WIFI=y
CONFIG_QCOM_WIFI=y
CONFIG_ETHERNET=y
CONFIG_SENSOR=y
CONFIG_BOARD_USES_DRM_HWCOMPOSER=y
CONFIG_BOARD_GPU_DRIVERS="freedreno virgl swrast vc4"
```

## configs/flo_defconfig
```kconfig
CONFIG_ARCH_ARM=y
CONFIG_BOARD_SYSTEMIMAGE_PARTITION_SIZE=880803840
CONFIG_KERNEL=y
CONFIG_KERNEL_PATH="zImage.dtb"
CONFIG_BOARD_KERNEL_CMDLINE="console=ttyHSL0,115200,n8 user_debug=31 console=ttyMSM0,115200,n8 androidboot.selinux=permissive"
CONFIG_BOARD_KERNEL_BASE=0x80200000
CONFIG_RAMDISK_OFFSET=0x02000000
CONFIG_QCOM_FLO_WIFI=y
```

## configs/hikey_defconfig
```kconfig
CONFIG_BOARD_SYSTEMIMAGE_PARTITION_SIZE=1610612736
CONFIG_HWCOMPOSER=y
CONFIG_GRALLOC_MALI=y
CONFIG_DALVIK_VM_HEAPSTARTSIZE=16
CONFIG_DALVIK_VM_HEAPGROWTHLIMIT=192
CONFIG_DALVIK_VM_HEAPSIZE=512
```

## configs/linaro_arm64_defconfig
```kconfig
CONFIG_FIRMWARE=y
CONFIG_FIRMWARE_ALL=y
CONFIG_BOARD_GPU_DRIVERS="freedreno virgl vc4"
CONFIG_BOARD_HAVE_BLUETOOTH_LINUX=y
CONFIG_SENSOR=y
```

## configs/linaro_arm64_only_defconfig
```kconfig
# CONFIG_HAS_2ND_ARCH is not set
CONFIG_PRODUCT_DEVICE="linaro_arm64_only"
CONFIG_FIRMWARE=y
CONFIG_FIRMWARE_ALL=y
CONFIG_BOARD_GPU_DRIVERS="freedreno virgl vc4"
CONFIG_BOARD_HAVE_BLUETOOTH_LINUX=y
CONFIG_QCOM_WIFI=y
CONFIG_SENSOR=y
```

## configs/linaro_arm_defconfig
```kconfig
CONFIG_ARCH_ARM=y
CONFIG_FIRMWARE=y
CONFIG_FIRMWARE_ALL=y
CONFIG_BOARD_HAVE_BLUETOOTH_LINUX=y
CONFIG_QCOM_WIFI=y
CONFIG_TI_WILINK_WIFI=y
CONFIG_SENSOR=y
```

## configs/linaro_x86_64_defconfig
```kconfig
CONFIG_ARCH_X86_64=y
CONFIG_FIRMWARE=y
CONFIG_FIRMWARE_ALL=y
CONFIG_BOARD_GPU_DRIVERS="freedreno virgl swrast vc4"
CONFIG_BOARD_HAVE_BLUETOOTH_LINUX=y
CONFIG_SENSOR=y
```

## firmware/Kconfig
```kconfig
config FIRMWARE
	bool "Include linux-firmware files"

config FIRMWARE_ALL
	bool "Include all linux-firmware files"
	depends on FIRMWARE

config FIRMWARE_FILES
	string "Firmware files"
	depends on !FIRMWARE_ALL
	depends on FIRMWARE
	help
	  A comma separated list of firmware files to copy. Paths shall be
	  relative to the base of linux-firmware repository.
```

## graphics/Kconfig
```kconfig
menu "Graphics support"

config SW_GRAPHICS
	bool "Force Software rendering"

if !SW_GRAPHICS

config HWCOMPOSER
	bool
	default y if BOARD_USES_DRM_HWCOMPOSER
	default y if GRALLOC_MALI

choice
	prompt "HWComposer support"
	default BOARD_USES_DRM_HWCOMPOSER

config BOARD_USES_DRM_HWCOMPOSER
	bool "DRM HWComposer"

config GRALLOC_MALI
	bool "Gralloc support for Mali"

endchoice

config TARGET_USES_HWC2
	bool "HWComposer 2 support"
	depends on BOARD_USES_DRM_HWCOMPOSER

config BOARD_GPU_DRIVERS
	string "Mesa GPU drivers"
	depends on BOARD_USES_DRM_HWCOMPOSER
	default "freedreno virgl"

endif
config DISPLAY_DPI
	int "Display DPI setting override"
	default 0
	help
	  Sets the DPI value. If left as zero, the DPI will
	  be probed via EDID from the monitor or use values
	  from DT.
endmenu
```

## wifi/Kconfig
```kconfig
menuconfig WIFI
	bool "WiFi support"
	default y

if WIFI

config BOARD_WLAN_DEVICE
	string "Pick a vendor provided WiFi HAL implementation library."
	default ""
	help
	  Defaults to the fallback "vendor" hal library (libwifi-hal-fallback).
	  Other options include:
	    bcmdhd: Broadcom FullMAC wireless cards (libwifi-hal-bcm) support
	    qcwcn: Qualcomm generic WCN wifi hal (libwifi-hal-qcom) support
	    MediaTek: MTK wifi hal (libwifi-hal-mt66xx) support

config TI_WILINK_WIFI
	bool "TI WILINK wifi support"

endif
```
